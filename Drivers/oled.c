#include "oled.h"
#include "oled_fonts.h"
#include "main.h"

#define OLED_SCL_Pin GPIO_PIN_10
#define OLED_SDA_Pin GPIO_PIN_11
#define OLED_GPIO_Port GPIOB

#define OLED_SCL_HIGH HAL_GPIO_WritePin(OLED_GPIO_Port, OLED_SCL_Pin, GPIO_PIN_SET)
#define OLED_SCL_LOW HAL_GPIO_WritePin(OLED_GPIO_Port, OLED_SCL_Pin, GPIO_PIN_RESET)
#define OLED_SDA_HIGH HAL_GPIO_WritePin(OLED_GPIO_Port, OLED_SDA_Pin, GPIO_PIN_SET)
#define OLED_SDA_LOW HAL_GPIO_WritePin(OLED_GPIO_Port, OLED_SDA_Pin, GPIO_PIN_RESET)

static void OLED_I2C_Delay(void)
{
    uint8_t i;
    for(i=0; i<10; i++);
}

static void OLED_I2C_Start(void)
{
    OLED_SDA_HIGH;
    OLED_SCL_HIGH;
    OLED_I2C_Delay();
    OLED_SDA_LOW;
    OLED_I2C_Delay();
    OLED_SCL_LOW;
}

static void OLED_I2C_Stop(void)
{
    OLED_SDA_LOW;
    OLED_SCL_HIGH;
    OLED_I2C_Delay();
    OLED_SDA_HIGH;
    OLED_I2C_Delay();
}

static void OLED_I2C_Send_Byte(uint8_t byte)
{
    uint8_t i;
    for(i=0; i<8; i++)
    {
        if(byte & 0x80)
            OLED_SDA_HIGH;
        else
            OLED_SDA_LOW;
        byte <<= 1;
        OLED_SCL_HIGH;
        OLED_I2C_Delay();
        OLED_SCL_LOW;
        OLED_I2C_Delay();
    }
    OLED_SCL_HIGH;
    OLED_I2C_Delay();
    OLED_SCL_LOW;
}

static void OLED_I2C_Init(void)
{
    GPIO_InitTypeDef GPIO_InitStruct = {0};
    
    __HAL_RCC_GPIOB_CLK_ENABLE();
    
    GPIO_InitStruct.Pin = OLED_SCL_Pin | OLED_SDA_Pin;
    GPIO_InitStruct.Mode = GPIO_MODE_OUTPUT_OD;
    GPIO_InitStruct.Pull = GPIO_PULLUP;
    GPIO_InitStruct.Speed = GPIO_SPEED_FREQ_HIGH;
    HAL_GPIO_Init(OLED_GPIO_Port, &GPIO_InitStruct);
    
    OLED_SCL_HIGH;
    OLED_SDA_HIGH;
}

static void OLED_Write_Cmd(uint8_t cmd)
{
    OLED_I2C_Start();
    OLED_I2C_Send_Byte(OLED_I2C_ADDR);
    OLED_I2C_Send_Byte(0x00);
    OLED_I2C_Send_Byte(cmd);
    OLED_I2C_Stop();
}

static void OLED_Write_Data(uint8_t data)
{
    OLED_I2C_Start();
    OLED_I2C_Send_Byte(OLED_I2C_ADDR);
    OLED_I2C_Send_Byte(0x40);
    OLED_I2C_Send_Byte(data);
    OLED_I2C_Stop();
}

void OLED_Init(void)
{
    OLED_I2C_Init();
    HAL_Delay(100);
    
    OLED_Write_Cmd(0xAE);
    OLED_Write_Cmd(0xD5);
    OLED_Write_Cmd(0x80);
    OLED_Write_Cmd(0xA8);
    OLED_Write_Cmd(0x3F);
    OLED_Write_Cmd(0xD3);
    OLED_Write_Cmd(0x00);
    OLED_Write_Cmd(0x40);
    OLED_Write_Cmd(0x8D);
    OLED_Write_Cmd(0x14);
    OLED_Write_Cmd(0x20);
    OLED_Write_Cmd(0x02);
    OLED_Write_Cmd(0xA1);
    OLED_Write_Cmd(0xC8);
    OLED_Write_Cmd(0xDA);
    OLED_Write_Cmd(0x12);
    OLED_Write_Cmd(0x81);
    OLED_Write_Cmd(0xFF);
    OLED_Write_Cmd(0xD9);
    OLED_Write_Cmd(0xF1);
    OLED_Write_Cmd(0xDB);
    OLED_Write_Cmd(0x40);
    OLED_Write_Cmd(0xA4);
    OLED_Write_Cmd(0xA6);
    OLED_Write_Cmd(0xAF);
    
    OLED_Clear();
}

void OLED_Clear(void)
{
    uint8_t i, j;
    for(i=0; i<8; i++)
    {
        OLED_Write_Cmd(0xB0 + i);
        OLED_Write_Cmd(0x00);
        OLED_Write_Cmd(0x10);
        for(j=0; j<128; j++)
        {
            OLED_Write_Data(0x00);
        }
    }
}

void OLED_Fill(uint8_t data)
{
    uint8_t i, j;
    for(i=0; i<8; i++)
    {
        OLED_Write_Cmd(0xB0 + i);
        OLED_Write_Cmd(0x00);
        OLED_Write_Cmd(0x10);
        for(j=0; j<128; j++)
        {
            OLED_Write_Data(data);
        }
    }
}

void OLED_Set_Pos(uint8_t x, uint8_t y)
{
    OLED_Write_Cmd(0xB0 + y);
    OLED_Write_Cmd(((x & 0xF0) >> 4) | 0x10);
    OLED_Write_Cmd(x & 0x0F);
}

void OLED_Show_Char(uint8_t x, uint8_t y, uint8_t chr)
{
    uint8_t c = chr - ' ';
    uint8_t i;
    
    OLED_Set_Pos(x, y);
    for(i=0; i<8; i++)
    {
        OLED_Write_Data(OLED_F8x16[c][i]);
    }
    
    OLED_Set_Pos(x, y + 1);
    for(i=8; i<16; i++)
    {
        OLED_Write_Data(OLED_F8x16[c][i]);
    }
}

void OLED_Show_String(uint8_t x, uint8_t y, uint8_t *str)
{
    while(*str != '\0')
    {
        OLED_Show_Char(x, y, *str);
        x += 8;
        str++;
    }
}

void OLED_Draw_BMP(uint8_t x, uint8_t y, uint8_t width, uint8_t height, const uint8_t *bitmap)
{
    uint8_t pages = (height + 7) / 8;
    uint8_t page, col;

    for(page = 0; page < pages; page++)
    {
        OLED_Set_Pos(x, y + page);
        for(col = 0; col < width; col++)
        {
            OLED_Write_Data(bitmap[page * width + col]);
        }
    }
}

const uint8_t OLED_F8x16[96][16] = {
    {0x00,0x00,0x00,0x00,0x00,0x00,0x00,0x00,0x00,0x00,0x00,0x00,0x00,0x00,0x00,0x00},
    {0x00,0x00,0x00,0xF8,0x00,0x00,0x00,0x00,0x00,0x00,0x00,0x38,0x00,0x00,0x00,0x00},
    {0x00,0x00,0x00,0x00,0x00,0x00,0x00,0x00,0x00,0x00,0x00,0x00,0x00,0x00,0x00,0x00},
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    {0x00,0x00,0x00,0x00,0xFE,0x00,0x00,0x00,0x00,0x00,0x00,0x00,0x1F,0x00,0x00,0x00}
};
